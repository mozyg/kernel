## drivers/usb/gadget/composite/Kconfig
```kconfig
menu "USB Composite Gadget Support"

config USB_COMPOSITE
	bool "Composite Gadget support"
	depends on USB_GADGET && USB_GADGET_SELECTED
	default n
	help
          Gadget drivers are configured as a composite device

choice
	prompt "USB Composite Gadget Drivers"
	default USB_COMPOSITE_ETH_AND_STORAGE
	depends on USB_GADGET && USB_GADGET_SELECTED

config USB_COMPOSITE_ETH_AND_STORAGE
	tristate "Ethernet + Storage Gadget"
	depends on USB_COMPOSITE
	help
	  This composite drivers includes Ethernet and Storage drivers.
endchoise

endmenu
```
